/*
 * Device Tree overlay for ALPS rotary input 
 *
 * compile:
 * dtc -@ -I dts -O dtb -o gpio-rotary.dtbo gpio-rotary.dts
 *
 * armbian-add-overlay gpio-rotary.dts
 */

/dts-v1/;
/plugin/;

/ {
	model = "Orange Pi 5";
	compatible = "rockchip,rk3588s-orangepi-5", "rockchip,rk3588";

	fragment@0 {
		__overlay__ {
			pinctrl_rotary: pinctrl_rotary {
				rockchip,pins = <1 RK_PC4 RK_FUNC_GPIO &pcfg_pull_none>, <1 RK_PA3 RK_FUNC_GPIO &pcfg_pull_none>;
			};
		};
	};

	fragment@1 {
		target-path = "/";
		__overlay__ {
			rotary_axis {
				/* https://mchehab.fedorapeople.org/kernel_docs/input/devices/rotary-encoder.html */
				compatible = "rotary-encoder";
				pinctrl-names = "default";
				pinctrl-0 = <&pinctrl_rotary>;
				gpios = <&gpio1 RK_PC4 GPIO_ACTIVE_LOW>,<&gpio1 RK_PA3 GPIO_ACTIVE_LOW>;
				linux,axis = <1>; /* REL_Y */
				rotary-encoder,relative-axis;
				rotary-encoder,half-period;
			};
		};
	};
};
